## Kconfig.auto
```kconfig
config  CONTROL_CARTOON 
        bool "cartoon Control" 
        help 
			path=./widget/cartoon

config  CONTROL_LJ_LOCK 
        bool "lj_lock Control" 
        help 
		path=./widget/luo/lj_lock


config  CONTROL_LJ_DRAG_VERTICAL_EXPLAIN 
        bool "lj_drag_vertical_explain Control" 
        help 
        <lj_drag_vertical_explain name=explain x=30 y=40 width="240" height="170" >
    			<img>main/TEXT1.png</img>
    		</lj_drag_vertical_explain>
			path=./widget/luo/lj_drag_vertical_explain

config  CONTROL_LJ_DRAG_IMAGE 
      	bool "lj_drag_image Control" 
        help 
		path=./widget/luo/lj_drag_image


config  CONTROL_LJ_SCREENSAVER
        bool "lj_screensaver Control" 
        help 
        	<screensaver ptimer=5000 run='./tongs_pre.sh'/>
        	wait 5 sec into tongs_pre.sh seript
			path=./widget/luo/lj_screensaver


config  CONTROL_RADIO_BUTTONS 
        bool "Radig Buttons Control" 
        help 
	<Radio_buttons name="xzrf" select="4rf">
	    <node name="1rf" x="22"   y="54"  width="112" height="51" var="0" cs="fl1">
	    	<up>button/1-1.png</up>
	    	<dn>button/1-2.png</dn>
	    </node>
	    <node name="2rf" x="134"   y="54"  width="109" height="51" var="1" cs="fl2">
	    	<up>button/2-1.png</up>
	    	<dn>button/2-2.png</dn>
	    </node>
	    <node name="3rf" x="243"   y="54" width="109" height="51" var="2" cs="fl3">
	    	<up>button/3-1.png</up>
	    	<dn>button/3-2.png</dn>
	    </node>
	    <node name="4rf" x="352"   y="54"  width="112" height="51" var="3" cs="fl4">
	    	<up>button/4-1.png</up>
	    	<dn>button/4-2.png</dn>
	    </node>
    	</Radio_buttons>
			path=./widget/radio_bottons


config  CONTROL_BUTTON 
        bool "button Control" 
        help 
			path=./widget/button

config  CONTROL_STATIC_IMAGE 
        bool "static_image Control" 
        help 
			path=./widget/static_image

config  CONTROL_DRAG_MENU 
        bool "drag_menu Control" 
        help 
			path=./widget/hu/drag_menu
 

config  CONTROL_GESTURE 
        bool "gesture Control" 
		help 
			path=./widget/hu/gesture


config  CONTROL_STATIC_TEXT 
        depends on USING_FONT 
        bool "static_text Control" 
        help 
			path=./widget/static_text
```
